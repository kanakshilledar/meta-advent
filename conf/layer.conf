## conf/layer.conf
```bitbake
# We have a conf and classes directory, add to BBPATH
BBPATH .= ":${LAYERDIR}"

# We have recipes-* directories, add to BBFILES
BBFILES += "${LAYERDIR}/recipes-*/*/*.bb \
            ${LAYERDIR}/recipes-*/*/*.bbappend"

BBFILE_COLLECTIONS += "meta-advent"
BBFILE_PATTERN_meta-advent = "^${LAYERDIR}/"
BBFILE_PRIORITY_meta-advent = "6"

LAYERDEPENDS_meta-advent = "core"
LAYERSERIES_COMPAT_meta-advent = "whinlatter"
```
